/dts-v1/;/plugin/;
/ {
	fragment@0 
	{
		target-path = "/soc/fpga-region0";
		__overlay__ 
		{
			firmware-name = "DE10_NANO.rbf";
		};
	};


	fragment@1 
	{
		target-path = "/soc/amba";
		__overlay__ 
		{
			udmabuf
			{
				compatible = "ikwzm,u-dma-buf";
				device-name = "udmabuf0";
				size = <0x04000000>;
			};
        };
	} ;

};
